## arch/arm/mach-nuc97/Kconfig
```kconfig
if ARCH_NUC97

config NUC970
	bool
	default y
	
choice
	prompt "NUC970 board select"
	optional
	
config TARGET_NUC970_POS
	bool "Support Nuc970-pos"
	select BOARD_LATE_INIT
	select BOARD_EARLY_INIT_F
	select CREATE_ARCH_SYMLINK
	
endchoice

source "board/nuvoton/nuc970-pos/Kconfig"

endif
```

## board/nuvoton/nuc970-pos/Kconfig
```kconfig
if TARGET_NUC970_POS

config SYS_BOARD
	default "nuc970-pos"

config SYS_VENDOR
	default "nuvoton"

config SYS_SOC
	default "nuc97"

config SYS_CONFIG_NAME
	default "nuc970_pos"

endif
```
